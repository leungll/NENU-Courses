;/*
;************************************************************************************************************
;*									 	北京精仪达盛科技有限公司
;*                                     	   研    发    部
;*
;*                                 	     http://www.techshine.com
;*
;*--------------------------------------------- 文件信息 -----------------------------------------------------                                      
;* 文件名称 : memcfg.inc	
;* 文件功能 : 该文件为S3C44B0硬件平台的存储器配置文件，包括各访问参数的定义。
;* 补充说明 : 基于S3C44B0的ARM7硬件平台的CPU配置文件
;*-------------------------------------------- 最新版本信息 -------------------------------------------------
;* 修改作者 : ARM开发小组
;* 修改日期 : 2004/04/25
;* 版本声明 : V1.0.1
;*-------------------------------------------- 历史版本信息 -------------------------------------------------
;* 文件作者 : ARM开发小组
;* 创建日期 : 2004/04/20
;* 版本声明 : v1.0.0
;*-----------------------------------------------------------------------------------------------------------
;*-----------------------------------------------------------------------------------------------------------
;************************************************************************************************************
;*/

;/******************************************* Bank 0 参数设置 **********************************************/
B0_Tacs		EQU	0x0	;//0clk
B0_Tcos		EQU	0x0	;//0clk
B0_Tacc		EQU	0x6	;//10clk
B0_Tcoh		EQU	0x0	;//0clk
B0_Tah		EQU	0x0	;//0clk
B0_Tacp		EQU	0x0	;//0clk
B0_PMC		EQU	0x0	;//normal(1data)

;/******************************************* Bank 1 参数设置 **********************************************/
B1_Tacs		EQU	0x3	;//4clk
B1_Tcos		EQU	0x3	;//4clk
B1_Tacc		EQU	0x7	;//14clk
B1_Tcoh		EQU	0x3	;//4clk
B1_Tah		EQU	0x3	;//4clk
B1_Tacp		EQU	0x3	;//6clk
B1_PMC		EQU	0x0	;//normal(1data)

;/******************************************* Bank 2 参数设置 **********************************************/
B2_Tacs		EQU	0x3	;//4clk
B2_Tcos		EQU	0x3	;//4clk
B2_Tacc		EQU	0x7	;//14clk
B2_Tcoh		EQU	0x3	;//4clk
B2_Tah		EQU	0x3	;//4clk
B2_Tacp		EQU	0x3	;//6clk
B2_PMC		EQU	0x0	;//normal(1data)

;/******************************************* Bank 3 参数设置 **********************************************/
B3_Tacs		EQU	0x3	;//4clk
B3_Tcos		EQU	0x3	;//4clk
B3_Tacc		EQU	0x7	;//14clk
B3_Tcoh		EQU	0x3	;//4clk
B3_Tah		EQU	0x3	;//4clk
B3_Tacp		EQU	0x3	;//6clk
B3_PMC		EQU	0x0	;//normal(1data)

;/******************************************* Bank 4 参数设置 **********************************************/
B4_Tacs		EQU	0x3	;//4clk
B4_Tcos		EQU	0x3	;//4clk
B4_Tacc		EQU	0x7	;//14clk
B4_Tcoh		EQU	0x3	;//4clk
B4_Tah		EQU	0x3	;//4clk
B4_Tacp		EQU	0x3	;//6clk
B4_PMC		EQU	0x0	;//normal(1data)

;/******************************************* Bank 5 参数设置 **********************************************/
B5_Tacs		EQU	0x3	;//4clk
B5_Tcos		EQU	0x3	;//4clk
B5_Tacc		EQU	0x7	;//14clk
B5_Tcoh		EQU	0x3	;//4clk
B5_Tah		EQU	0x3	;//4clk
B5_Tacp		EQU	0x3	;//6clk
B5_PMC		EQU	0x0	;//normal(1data)

;/******************************************* Bank 6 参数设置 **********************************************/
B6_Tacs		EQU	0x3	;//4clk
B6_Tcos		EQU	0x3	;//4clk
B6_Tacc		EQU	0x7	;//14clk
B6_Tcoh		EQU	0x3	;//4clk
B6_Tah		EQU	0x3	;//4clk
B6_Tacp		EQU	0x3	;//6clk
B6_PMC		EQU	0x0	;//normal(1data)

;/******************************************* Bank 7 参数设置 **********************************************/
B7_Tacs		EQU	0x3	;//4clk
B7_Tcos		EQU	0x3	;//4clk
B7_Tacc		EQU	0x7	;//14clk
B7_Tcoh		EQU	0x3	;//4clk
B7_Tah		EQU	0x3	;//4clk
B7_Tacp		EQU	0x3	;//6clk
B7_PMC		EQU	0x0	;//normal(1data)

;/******************************************* Bank 6 参数设置 **********************************************/
    [ BDRAMTYPE = "DRAM"	;//MT=01(FP DRAM) 或 10(EDO DRAM) 
B6_MT		EQU	0x2	;//EDO DRAM
B6_Trcd		EQU	0x0	;//1clk
B6_Tcas		EQU	0x0	;//1clk
B6_Tcp		EQU	0x0	;//1clk
B6_CAN		EQU	0x2	;//10bit
	| 			;//"SDRAM"		;MT=11(SDRAM)
B6_MT		EQU	0x3	;//SDRAM
B6_Trcd		EQU	0x0	;//2clk
B6_SCAN		EQU	0x0	;//8bit
	]
	
;/******************************************* Bank 7 参数设置 **********************************************/
	[ BDRAMTYPE = "DRAM"	;//MT=01(FP DRAM) 或 10(EDO DRAM) 
B7_MT		EQU	0x2	;//EDO DRAM
B7_Trcd		EQU	0x0	;//2clk
B7_Tcas		EQU	0x0	;//2clk
B7_Tcp		EQU	0x0	;//2clk
B7_CAN		EQU	0x2	;//10bit
	| 			;//"SDRAM"		;//MT=11(SDRAM)
B7_MT		EQU	0x3	;//SDRAM
B7_Trcd		EQU	0x0	;//2clk
B7_SCAN		EQU	0x0	;//8bit
	]

;/******************************************* REFRESH 参数设置 *********************************************/
REFEN		EQU	0x1	;//自更新使能
TREFMD		EQU	0x0	;//CBR(CAS before RAS)/自更新
Trp			EQU	0x0	;//2clk
;//Trc		EQU	0x0	;//4clk
;//Tchr		EQU	0x2	;//3clk
;//REFCNT	EQU	1425	;//周期=15.6us, MCLK=40Mhz
Trc			EQU	0x1	;//5clk
Tchr		EQU	0x2	;//3clk
;//REFCNT = 2048 + 1 - MCLK(MHz) * 15.6
REFCNT		EQU	1113	;//period=15.6us, MCLK=60Mhz

;/**********************************************************************************************************/
	END
